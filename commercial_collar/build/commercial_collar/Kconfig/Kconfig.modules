## commercial_collar/build/commercial_collar/Kconfig/Kconfig.modules
```kconfig
menu "nrf (D:/xiao_tian_ling_v0.2/tracker_fw_sdk_V2_8_0/nrf)"
osource "D:/xiao_tian_ling_v0.2/tracker_fw_sdk_V2_8_0/nrf/Kconfig.nrf"
config ZEPHYR_NRF_MODULE
	bool
	default y
endmenu
menu "mcuboot (D:/xiao_tian_ling_v0.2/tracker_fw_sdk_V2_8_0/bootloader/mcuboot)"
osource "$(ZEPHYR_MCUBOOT_KCONFIG)"
config ZEPHYR_MCUBOOT_MODULE
	bool
	default y
endmenu
menu "mbedtls (D:/xiao_tian_ling_v0.2/tracker_fw_sdk_V2_8_0/modules/crypto/mbedtls)"
osource "$(ZEPHYR_MBEDTLS_KCONFIG)"
config ZEPHYR_MBEDTLS_MODULE
	bool
	default y
endmenu
menu "oberon-psa-crypto (D:/xiao_tian_ling_v0.2/tracker_fw_sdk_V2_8_0/modules/crypto/oberon-psa-crypto)"
osource "D:/xiao_tian_ling_v0.2/tracker_fw_sdk_V2_8_0/modules/crypto/oberon-psa-crypto/Kconfig.oberon_psa_crypto"
config ZEPHYR_OBERON_PSA_CRYPTO_MODULE
	bool
	default y
endmenu
menu "trusted-firmware-m (D:/xiao_tian_ling_v0.2/tracker_fw_sdk_V2_8_0/modules/tee/tf-m/trusted-firmware-m)"
osource "$(ZEPHYR_TRUSTED_FIRMWARE_M_KCONFIG)"
config ZEPHYR_TRUSTED_FIRMWARE_M_MODULE
	bool
	default y
endmenu
config ZEPHYR_PSA_ARCH_TESTS_MODULE
	bool
	default y
config ZEPHYR_SOC_HWMV1_MODULE
	bool
	default y
menu "cjson (D:/xiao_tian_ling_v0.2/tracker_fw_sdk_V2_8_0/modules/lib/cjson)"
osource "$(ZEPHYR_CJSON_KCONFIG)"
config ZEPHYR_CJSON_MODULE
	bool
	default y
endmenu
menu "azure-sdk-for-c (D:/xiao_tian_ling_v0.2/tracker_fw_sdk_V2_8_0/modules/lib/azure-sdk-for-c)"
osource "$(ZEPHYR_AZURE_SDK_FOR_C_KCONFIG)"
config ZEPHYR_AZURE_SDK_FOR_C_MODULE
	bool
	default y
endmenu
menu "cirrus-logic (D:/xiao_tian_ling_v0.2/tracker_fw_sdk_V2_8_0/modules/hal/cirrus-logic)"
osource "D:/xiao_tian_ling_v0.2/tracker_fw_sdk_V2_8_0/modules/hal/cirrus-logic/Kconfig"
config ZEPHYR_CIRRUS_LOGIC_MODULE
	bool
	default y
endmenu
menu "openthread (D:/xiao_tian_ling_v0.2/tracker_fw_sdk_V2_8_0/modules/lib/openthread)"
osource "$(ZEPHYR_OPENTHREAD_KCONFIG)"
config ZEPHYR_OPENTHREAD_MODULE
	bool
	default y
endmenu
menu "suit-generator (D:/xiao_tian_ling_v0.2/tracker_fw_sdk_V2_8_0/modules/lib/suit-generator)"
osource "D:/xiao_tian_ling_v0.2/tracker_fw_sdk_V2_8_0/modules/lib/suit-generator/ncs/Kconfig"
config ZEPHYR_SUIT_GENERATOR_MODULE
	bool
	default y
endmenu
menu "suit-processor (D:/xiao_tian_ling_v0.2/tracker_fw_sdk_V2_8_0/modules/lib/suit-processor)"
osource "D:/xiao_tian_ling_v0.2/tracker_fw_sdk_V2_8_0/modules/lib/suit-processor/Kconfig"
config ZEPHYR_SUIT_PROCESSOR_MODULE
	bool
	default y
endmenu
menu "memfault-firmware-sdk (D:/xiao_tian_ling_v0.2/tracker_fw_sdk_V2_8_0/modules/lib/memfault-firmware-sdk)"
osource "D:/xiao_tian_ling_v0.2/tracker_fw_sdk_V2_8_0/modules/lib/memfault-firmware-sdk/ports/zephyr/Kconfig"
config ZEPHYR_MEMFAULT_FIRMWARE_SDK_MODULE
	bool
	default y
endmenu
menu "coremark (D:/xiao_tian_ling_v0.2/tracker_fw_sdk_V2_8_0/modules/benchmark/coremark)"
osource "$(ZEPHYR_COREMARK_KCONFIG)"
config ZEPHYR_COREMARK_MODULE
	bool
	default y
endmenu
menu "canopennode (D:/xiao_tian_ling_v0.2/tracker_fw_sdk_V2_8_0/modules/lib/canopennode)"
osource "$(ZEPHYR_CANOPENNODE_KCONFIG)"
config ZEPHYR_CANOPENNODE_MODULE
	bool
	default y
endmenu
menu "chre (D:/xiao_tian_ling_v0.2/tracker_fw_sdk_V2_8_0/modules/lib/chre)"
osource "D:/xiao_tian_ling_v0.2/tracker_fw_sdk_V2_8_0/modules/lib/chre/platform/zephyr/Kconfig"
config ZEPHYR_CHRE_MODULE
	bool
	default y
endmenu
menu "lz4 (D:/xiao_tian_ling_v0.2/tracker_fw_sdk_V2_8_0/modules/lib/lz4)"
osource "$(ZEPHYR_LZ4_KCONFIG)"
config ZEPHYR_LZ4_MODULE
	bool
	default y
endmenu
menu "nanopb (D:/xiao_tian_ling_v0.2/tracker_fw_sdk_V2_8_0/modules/lib/nanopb)"
osource "$(ZEPHYR_NANOPB_KCONFIG)"
config ZEPHYR_NANOPB_MODULE
	bool
	default y
endmenu
config ZEPHYR_TF_M_TESTS_MODULE
	bool
	default y
menu "zscilib (D:/xiao_tian_ling_v0.2/tracker_fw_sdk_V2_8_0/modules/lib/zscilib)"
osource "D:/xiao_tian_ling_v0.2/tracker_fw_sdk_V2_8_0/modules/lib/zscilib/Kconfig.zscilib"
config ZEPHYR_ZSCILIB_MODULE
	bool
	default y
endmenu
menu "cmsis (D:/xiao_tian_ling_v0.2/tracker_fw_sdk_V2_8_0/modules/hal/cmsis)"
osource "$(ZEPHYR_CMSIS_KCONFIG)"
config ZEPHYR_CMSIS_MODULE
	bool
	default y
endmenu
menu "cmsis-dsp (D:/xiao_tian_ling_v0.2/tracker_fw_sdk_V2_8_0/modules/lib/cmsis-dsp)"
osource "$(ZEPHYR_CMSIS_DSP_KCONFIG)"
config ZEPHYR_CMSIS_DSP_MODULE
	bool
	default y
endmenu
menu "cmsis-nn (D:/xiao_tian_ling_v0.2/tracker_fw_sdk_V2_8_0/modules/lib/cmsis-nn)"
osource "$(ZEPHYR_CMSIS_NN_KCONFIG)"
config ZEPHYR_CMSIS_NN_MODULE
	bool
	default y
endmenu
menu "fatfs (D:/xiao_tian_ling_v0.2/tracker_fw_sdk_V2_8_0/modules/fs/fatfs)"
osource "$(ZEPHYR_FATFS_KCONFIG)"
config ZEPHYR_FATFS_MODULE
	bool
	default y
endmenu
menu "hal_nordic (D:/xiao_tian_ling_v0.2/tracker_fw_sdk_V2_8_0/modules/hal/nordic)"
osource "$(ZEPHYR_HAL_NORDIC_KCONFIG)"
config ZEPHYR_HAL_NORDIC_MODULE
	bool
	default y

config ZEPHYR_HAL_NORDIC_MODULE_BLOBS
	bool
endmenu
menu "hal_st (D:/xiao_tian_ling_v0.2/tracker_fw_sdk_V2_8_0/modules/hal/st)"
osource "$(ZEPHYR_HAL_ST_KCONFIG)"
config ZEPHYR_HAL_ST_MODULE
	bool
	default y
endmenu
config ZEPHYR_HAL_WURTHELEKTRONIK_MODULE
	bool
	default y
menu "hostap (D:/xiao_tian_ling_v0.2/tracker_fw_sdk_V2_8_0/modules/lib/hostap)"
osource "$(ZEPHYR_HOSTAP_KCONFIG)"
config ZEPHYR_HOSTAP_MODULE
	bool
	default y
endmenu
config ZEPHYR_LIBMETAL_MODULE
	bool
	default y
menu "liblc3 (D:/xiao_tian_ling_v0.2/tracker_fw_sdk_V2_8_0/modules/lib/liblc3)"
osource "$(ZEPHYR_LIBLC3_KCONFIG)"
config ZEPHYR_LIBLC3_MODULE
	bool
	default y
endmenu
menu "littlefs (D:/xiao_tian_ling_v0.2/tracker_fw_sdk_V2_8_0/modules/fs/littlefs)"
osource "$(ZEPHYR_LITTLEFS_KCONFIG)"
config ZEPHYR_LITTLEFS_MODULE
	bool
	default y
endmenu
menu "loramac-node (D:/xiao_tian_ling_v0.2/tracker_fw_sdk_V2_8_0/modules/lib/loramac-node)"
osource "$(ZEPHYR_LORAMAC_NODE_KCONFIG)"
config ZEPHYR_LORAMAC_NODE_MODULE
	bool
	default y
endmenu
menu "lvgl (D:/xiao_tian_ling_v0.2/tracker_fw_sdk_V2_8_0/modules/lib/gui/lvgl)"
osource "D:/xiao_tian_ling_v0.2/tracker_fw_sdk_V2_8_0/modules/lib/gui/lvgl/Kconfig"
config ZEPHYR_LVGL_MODULE
	bool
	default y
endmenu
config ZEPHYR_MIPI_SYS_T_MODULE
	bool
	default y
config ZEPHYR_NRF_HW_MODELS_MODULE
	bool
	default y
config ZEPHYR_OPEN_AMP_MODULE
	bool
	default y
menu "picolibc (D:/xiao_tian_ling_v0.2/tracker_fw_sdk_V2_8_0/modules/lib/picolibc)"
osource "D:/xiao_tian_ling_v0.2/tracker_fw_sdk_V2_8_0/modules/lib/picolibc/zephyr/Kconfig"
config ZEPHYR_PICOLIBC_MODULE
	bool
	default y
endmenu
menu "segger (D:/xiao_tian_ling_v0.2/tracker_fw_sdk_V2_8_0/modules/debug/segger)"
osource "$(ZEPHYR_SEGGER_KCONFIG)"
config ZEPHYR_SEGGER_MODULE
	bool
	default y
endmenu
config ZEPHYR_TINYCRYPT_MODULE
	bool
	default y
menu "uoscore-uedhoc (D:/xiao_tian_ling_v0.2/tracker_fw_sdk_V2_8_0/modules/lib/uoscore-uedhoc)"
osource "$(ZEPHYR_UOSCORE_UEDHOC_KCONFIG)"
config ZEPHYR_UOSCORE_UEDHOC_MODULE
	bool
	default y
endmenu
menu "zcbor (D:/xiao_tian_ling_v0.2/tracker_fw_sdk_V2_8_0/modules/lib/zcbor)"
osource "$(ZEPHYR_ZCBOR_KCONFIG)"
config ZEPHYR_ZCBOR_MODULE
	bool
	default y
endmenu
menu "culvert_drivers (D:/xiao_tian_ling_v0.2/tracker_fw_sdk_V2_8_0/lib/drivers)"
osource "D:/xiao_tian_ling_v0.2/tracker_fw_sdk_V2_8_0/lib/drivers/Kconfig"
config ZEPHYR_CULVERT_DRIVERS_MODULE
	bool
	default y
endmenu
menu "nrfxlib (D:/xiao_tian_ling_v0.2/tracker_fw_sdk_V2_8_0/nrfxlib)"
osource "D:/xiao_tian_ling_v0.2/tracker_fw_sdk_V2_8_0/nrfxlib/Kconfig.nrfxlib"
config ZEPHYR_NRFXLIB_MODULE
	bool
	default y
endmenu
menu "connectedhomeip (D:/xiao_tian_ling_v0.2/tracker_fw_sdk_V2_8_0/modules/lib/matter)"
osource "D:/xiao_tian_ling_v0.2/tracker_fw_sdk_V2_8_0/modules/lib/matter/config/nrfconnect/chip-module/Kconfig"
config ZEPHYR_CONNECTEDHOMEIP_MODULE
	bool
	default y
endmenu
```

## dog_tracker/build/Kconfig/Kconfig.shield
```kconfig
osource "D:/xiao_tian_ling_v0.2/tracker_fw_sdk_V2_8_0/nrf/boards/shields/*/Kconfig.shield"
```

## dog_tracker/build/dog_tracker/Kconfig/arch/Kconfig
```kconfig
# Load Zephyr Arch Kconfig descriptions.
osource "D:/xiao_tian_ling_v0.2/tracker_fw_sdk_V2_8_0/zephyr/arch/x86/Kconfig"
osource "D:/xiao_tian_ling_v0.2/tracker_fw_sdk_V2_8_0/zephyr/arch/xtensa/Kconfig"
osource "D:/xiao_tian_ling_v0.2/tracker_fw_sdk_V2_8_0/zephyr/arch/sparc/Kconfig"
osource "D:/xiao_tian_ling_v0.2/tracker_fw_sdk_V2_8_0/zephyr/arch/riscv/Kconfig"
osource "D:/xiao_tian_ling_v0.2/tracker_fw_sdk_V2_8_0/zephyr/arch/posix/Kconfig"
osource "D:/xiao_tian_ling_v0.2/tracker_fw_sdk_V2_8_0/zephyr/arch/nios2/Kconfig"
osource "D:/xiao_tian_ling_v0.2/tracker_fw_sdk_V2_8_0/zephyr/arch/mips/Kconfig"
osource "D:/xiao_tian_ling_v0.2/tracker_fw_sdk_V2_8_0/zephyr/arch/arm64/Kconfig"
osource "D:/xiao_tian_ling_v0.2/tracker_fw_sdk_V2_8_0/zephyr/arch/arm/Kconfig"
osource "D:/xiao_tian_ling_v0.2/tracker_fw_sdk_V2_8_0/zephyr/arch/arc/Kconfig"
```

## dog_tracker/build/dog_tracker/Kconfig/boards/Kconfig.sysbuild
```kconfig
# Load Sysbuild board Kconfig descriptions.
osource "D:/xiao_tian_ling_v0.2/tracker_fw_sdk_V2_8_0/zephyr/boards/nordic/nrf54l15dk/Kconfig.sysbuild"
```
