## nrf54l15_bluetooth_app/build/nrf54l15_bluetooth_app/Kconfig/soc/Kconfig
```kconfig
# Load Zephyr SoC Kconfig descriptions.
osource "D:/xiao_tian_ling_v0.2/tracker_fw_sdk_V2_8_0/zephyr/soc/xlnx/zynqmp/Kconfig"
osource "D:/xiao_tian_ling_v0.2/tracker_fw_sdk_V2_8_0/zephyr/soc/xlnx/zynq7000/Kconfig"
osource "D:/xiao_tian_ling_v0.2/tracker_fw_sdk_V2_8_0/zephyr/soc/xen/Kconfig"
osource "D:/xiao_tian_ling_v0.2/tracker_fw_sdk_V2_8_0/zephyr/soc/ti/simplelink/Kconfig"
osource "D:/xiao_tian_ling_v0.2/tracker_fw_sdk_V2_8_0/zephyr/soc/ti/lm3s6965/Kconfig"
osource "D:/xiao_tian_ling_v0.2/tracker_fw_sdk_V2_8_0/zephyr/soc/ti/k3/Kconfig"
osource "D:/xiao_tian_ling_v0.2/tracker_fw_sdk_V2_8_0/zephyr/soc/telink/tlsr/Kconfig"
osource "D:/xiao_tian_ling_v0.2/tracker_fw_sdk_V2_8_0/zephyr/soc/starfive/jh71xx/Kconfig"
osource "D:/xiao_tian_ling_v0.2/tracker_fw_sdk_V2_8_0/zephyr/soc/st/stm32/Kconfig"
osource "D:/xiao_tian_ling_v0.2/tracker_fw_sdk_V2_8_0/zephyr/soc/snps/qemu_arc/Kconfig"
osource "D:/xiao_tian_ling_v0.2/tracker_fw_sdk_V2_8_0/zephyr/soc/snps/nsim/arc_v/Kconfig"
osource "D:/xiao_tian_ling_v0.2/tracker_fw_sdk_V2_8_0/zephyr/soc/snps/nsim/arc_classic/Kconfig"
osource "D:/xiao_tian_ling_v0.2/tracker_fw_sdk_V2_8_0/zephyr/soc/snps/hsdk4xd/Kconfig"
osource "D:/xiao_tian_ling_v0.2/tracker_fw_sdk_V2_8_0/zephyr/soc/snps/hsdk/Kconfig"
osource "D:/xiao_tian_ling_v0.2/tracker_fw_sdk_V2_8_0/zephyr/soc/snps/emsk/Kconfig"
osource "D:/xiao_tian_ling_v0.2/tracker_fw_sdk_V2_8_0/zephyr/soc/snps/emsdp/Kconfig"
osource "D:/xiao_tian_ling_v0.2/tracker_fw_sdk_V2_8_0/zephyr/soc/snps/arc_iot/Kconfig"
osource "D:/xiao_tian_ling_v0.2/tracker_fw_sdk_V2_8_0/zephyr/soc/silabs/Kconfig"
osource "D:/xiao_tian_ling_v0.2/tracker_fw_sdk_V2_8_0/zephyr/soc/sifive/sifive_freedom/Kconfig"
osource "D:/xiao_tian_ling_v0.2/tracker_fw_sdk_V2_8_0/zephyr/soc/sensry/Kconfig"
osource "D:/xiao_tian_ling_v0.2/tracker_fw_sdk_V2_8_0/zephyr/soc/rockchip/Kconfig"
osource "D:/xiao_tian_ling_v0.2/tracker_fw_sdk_V2_8_0/zephyr/soc/renode/riscv_virtual/Kconfig"
osource "D:/xiao_tian_ling_v0.2/tracker_fw_sdk_V2_8_0/zephyr/soc/renesas/smartbond/Kconfig"
osource "D:/xiao_tian_ling_v0.2/tracker_fw_sdk_V2_8_0/zephyr/soc/renesas/rzt2m/Kconfig"
osource "D:/xiao_tian_ling_v0.2/tracker_fw_sdk_V2_8_0/zephyr/soc/renesas/rcar/Kconfig"
osource "D:/xiao_tian_ling_v0.2/tracker_fw_sdk_V2_8_0/zephyr/soc/renesas/ra/Kconfig"
osource "D:/xiao_tian_ling_v0.2/tracker_fw_sdk_V2_8_0/zephyr/soc/raspberrypi/Kconfig"
osource "D:/xiao_tian_ling_v0.2/tracker_fw_sdk_V2_8_0/zephyr/soc/quicklogic/eos_s3/Kconfig"
osource "D:/xiao_tian_ling_v0.2/tracker_fw_sdk_V2_8_0/zephyr/soc/qemu/virt_riscv/Kconfig"
osource "D:/xiao_tian_ling_v0.2/tracker_fw_sdk_V2_8_0/zephyr/soc/qemu/malta/Kconfig"
osource "D:/xiao_tian_ling_v0.2/tracker_fw_sdk_V2_8_0/zephyr/soc/openisa/rv32m1/Kconfig"
osource "D:/xiao_tian_ling_v0.2/tracker_fw_sdk_V2_8_0/zephyr/soc/nxp/s32/Kconfig"
osource "D:/xiao_tian_ling_v0.2/tracker_fw_sdk_V2_8_0/zephyr/soc/nxp/rw/Kconfig"
osource "D:/xiao_tian_ling_v0.2/tracker_fw_sdk_V2_8_0/zephyr/soc/nxp/mcx/Kconfig"
osource "D:/xiao_tian_ling_v0.2/tracker_fw_sdk_V2_8_0/zephyr/soc/nxp/lpc/Kconfig"
osource "D:/xiao_tian_ling_v0.2/tracker_fw_sdk_V2_8_0/zephyr/soc/nxp/layerscape/Kconfig"
osource "D:/xiao_tian_ling_v0.2/tracker_fw_sdk_V2_8_0/zephyr/soc/nxp/kinetis/Kconfig"
osource "D:/xiao_tian_ling_v0.2/tracker_fw_sdk_V2_8_0/zephyr/soc/nxp/imxrt/Kconfig"
osource "D:/xiao_tian_ling_v0.2/tracker_fw_sdk_V2_8_0/zephyr/soc/nxp/imx/Kconfig"
osource "D:/xiao_tian_ling_v0.2/tracker_fw_sdk_V2_8_0/zephyr/soc/nuvoton/numicro/Kconfig"
osource "D:/xiao_tian_ling_v0.2/tracker_fw_sdk_V2_8_0/zephyr/soc/nuvoton/numaker/Kconfig"
osource "D:/xiao_tian_ling_v0.2/tracker_fw_sdk_V2_8_0/zephyr/soc/nuvoton/npcx/Kconfig"
osource "D:/xiao_tian_ling_v0.2/tracker_fw_sdk_V2_8_0/zephyr/soc/nuvoton/npcm/Kconfig"
osource "D:/xiao_tian_ling_v0.2/tracker_fw_sdk_V2_8_0/zephyr/soc/nordic/Kconfig"
osource "D:/xiao_tian_ling_v0.2/tracker_fw_sdk_V2_8_0/zephyr/soc/neorv32/Kconfig"
osource "D:/xiao_tian_ling_v0.2/tracker_fw_sdk_V2_8_0/zephyr/soc/native/inf_clock/Kconfig"
osource "D:/xiao_tian_ling_v0.2/tracker_fw_sdk_V2_8_0/zephyr/soc/microchip/miv/Kconfig"
osource "D:/xiao_tian_ling_v0.2/tracker_fw_sdk_V2_8_0/zephyr/soc/microchip/mec/Kconfig"
osource "D:/xiao_tian_ling_v0.2/tracker_fw_sdk_V2_8_0/zephyr/soc/mediatek/mtk_adsp/Kconfig"
osource "D:/xiao_tian_ling_v0.2/tracker_fw_sdk_V2_8_0/zephyr/soc/lowrisc/opentitan/Kconfig"
osource "D:/xiao_tian_ling_v0.2/tracker_fw_sdk_V2_8_0/zephyr/soc/litex/litex_vexriscv/Kconfig"
osource "D:/xiao_tian_ling_v0.2/tracker_fw_sdk_V2_8_0/zephyr/soc/ite/ec/Kconfig"
osource "D:/xiao_tian_ling_v0.2/tracker_fw_sdk_V2_8_0/zephyr/soc/intel/raptor_lake/Kconfig"
osource "D:/xiao_tian_ling_v0.2/tracker_fw_sdk_V2_8_0/zephyr/soc/intel/lakemont/Kconfig"
osource "D:/xiao_tian_ling_v0.2/tracker_fw_sdk_V2_8_0/zephyr/soc/intel/intel_socfpga_std/Kconfig"
osource "D:/xiao_tian_ling_v0.2/tracker_fw_sdk_V2_8_0/zephyr/soc/intel/intel_socfpga/Kconfig"
osource "D:/xiao_tian_ling_v0.2/tracker_fw_sdk_V2_8_0/zephyr/soc/intel/intel_niosv/Kconfig"
osource "D:/xiao_tian_ling_v0.2/tracker_fw_sdk_V2_8_0/zephyr/soc/intel/intel_ish/Kconfig"
osource "D:/xiao_tian_ling_v0.2/tracker_fw_sdk_V2_8_0/zephyr/soc/intel/intel_adsp/Kconfig"
osource "D:/xiao_tian_ling_v0.2/tracker_fw_sdk_V2_8_0/zephyr/soc/intel/elkhart_lake/Kconfig"
osource "D:/xiao_tian_ling_v0.2/tracker_fw_sdk_V2_8_0/zephyr/soc/intel/atom/Kconfig"
osource "D:/xiao_tian_ling_v0.2/tracker_fw_sdk_V2_8_0/zephyr/soc/intel/apollo_lake/Kconfig"
osource "D:/xiao_tian_ling_v0.2/tracker_fw_sdk_V2_8_0/zephyr/soc/intel/alder_lake/Kconfig"
osource "D:/xiao_tian_ling_v0.2/tracker_fw_sdk_V2_8_0/zephyr/soc/infineon/cat3/Kconfig"
osource "D:/xiao_tian_ling_v0.2/tracker_fw_sdk_V2_8_0/zephyr/soc/infineon/cat1b/Kconfig"
osource "D:/xiao_tian_ling_v0.2/tracker_fw_sdk_V2_8_0/zephyr/soc/infineon/cat1a/Kconfig"
osource "D:/xiao_tian_ling_v0.2/tracker_fw_sdk_V2_8_0/zephyr/soc/gd/gd32/Kconfig"
osource "D:/xiao_tian_ling_v0.2/tracker_fw_sdk_V2_8_0/zephyr/soc/gaisler/leon3/Kconfig"
osource "D:/xiao_tian_ling_v0.2/tracker_fw_sdk_V2_8_0/zephyr/soc/gaisler/gr716a/Kconfig"
osource "D:/xiao_tian_ling_v0.2/tracker_fw_sdk_V2_8_0/zephyr/soc/espressif/Kconfig"
osource "D:/xiao_tian_ling_v0.2/tracker_fw_sdk_V2_8_0/zephyr/soc/ene/kb1200/Kconfig"
osource "D:/xiao_tian_ling_v0.2/tracker_fw_sdk_V2_8_0/zephyr/soc/efinix/sapphire/Kconfig"
osource "D:/xiao_tian_ling_v0.2/tracker_fw_sdk_V2_8_0/zephyr/soc/cdns/xtensa_sample_controller/Kconfig"
osource "D:/xiao_tian_ling_v0.2/tracker_fw_sdk_V2_8_0/zephyr/soc/cdns/dc233c/Kconfig"
osource "D:/xiao_tian_ling_v0.2/tracker_fw_sdk_V2_8_0/zephyr/soc/brcm/bcmvk/Kconfig"
osource "D:/xiao_tian_ling_v0.2/tracker_fw_sdk_V2_8_0/zephyr/soc/brcm/bcm2712/Kconfig"
osource "D:/xiao_tian_ling_v0.2/tracker_fw_sdk_V2_8_0/zephyr/soc/brcm/bcm2711/Kconfig"
osource "D:/xiao_tian_ling_v0.2/tracker_fw_sdk_V2_8_0/zephyr/soc/atmel/sam0/Kconfig"
osource "D:/xiao_tian_ling_v0.2/tracker_fw_sdk_V2_8_0/zephyr/soc/atmel/sam/Kconfig"
osource "D:/xiao_tian_ling_v0.2/tracker_fw_sdk_V2_8_0/zephyr/soc/aspeed/Kconfig"
osource "D:/xiao_tian_ling_v0.2/tracker_fw_sdk_V2_8_0/zephyr/soc/arm/Kconfig"
osource "D:/xiao_tian_ling_v0.2/tracker_fw_sdk_V2_8_0/zephyr/soc/arm/beetle/Kconfig"
osource "D:/xiao_tian_ling_v0.2/tracker_fw_sdk_V2_8_0/zephyr/soc/andestech/Kconfig"
osource "D:/xiao_tian_ling_v0.2/tracker_fw_sdk_V2_8_0/zephyr/soc/ambiq/Kconfig"
osource "D:/xiao_tian_ling_v0.2/tracker_fw_sdk_V2_8_0/zephyr/soc/altr/zephyr_nios2f/Kconfig"
osource "D:/xiao_tian_ling_v0.2/tracker_fw_sdk_V2_8_0/zephyr/soc/altr/qemu_nios2/Kconfig"
osource "D:/xiao_tian_ling_v0.2/tracker_fw_sdk_V2_8_0/zephyr/soc/adi/max32/Kconfig"
```
